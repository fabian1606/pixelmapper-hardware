## node/firmware/components/pm_net/Kconfig
```kconfig
menu "Pixelmapper Node: Ethernet (pm_net)"

    comment "All Ethernet pins (RMII, MDC/MDIO, PHY reset/address, REF_CLK) come from pm_board."

    config PM_NET_PKTINFO
        bool
        default y
        select LWIP_NETBUF_RECVINFO
        help
            IP_PKTINFO on the Art-Net socket: pm_artnet needs the destination address of each datagram
            (ArtSync is accepted only as broadcast).

    config PM_NET_TASK_PRIO
        int "Network task priority"
        default 10
    config PM_NET_TASK_STACK
        int "Network task stack size"
        default 6144
    config PM_NET_POST_QUEUE_LEN
        int "pm_net_post queue length"
        default 32
endmenu
```

## node/firmware/components/pm_port/Kconfig
```kconfig
menu "Pixelmapper port engine (pm_port)"

    config PM_PORT_ISR_CACHE_SAFE
        bool "Keep DMX/RDM timing running while the flash cache is disabled"
        default y
        select GPTIMER_ISR_CACHE_SAFE if !SPI_FLASH_AUTO_SUSPEND
        select GPTIMER_CTRL_FUNC_IN_IRAM
        help
            Places the port ISRs (UART + timer) and the line state machine in IRAM and allocates the interrupts
            with ESP_INTR_FLAG_IRAM, so breaks and RDM turnarounds keep their timing during flash writes
            (OTA, NVS). Costs a few KB of IRAM.

    config PM_PORT_TASK_PRIORITY
        int "Priority of the port engine task (core 1)"
        default 22
        range 1 24

endmenu
```
